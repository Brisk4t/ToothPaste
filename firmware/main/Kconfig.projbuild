## firmware/main/Kconfig.projbuild
```kconfig
menu "ToothPaste"

    config TOOTHPASTE_SOFTWARE_CRYPTO
        bool "Use software crypto (mbedTLS / PSA)"
        default n
        help
            Perform ECDH key generation and shared-secret derivation entirely
            in software via mbedTLS PSA Crypto. When disabled, the ATECC608
            secure element handles key operations so private key material never
            enters RAM.

    config TOOTHPASTE_RGB_LED_PIN
        int "RGB LED GPIO pin"
        default 12
        range 0 48
        help
            GPIO pin number connected to the WS2812 RGB LED data line.

endmenu
```

## firmware/sdkconfig.defaults.4mb_mbedtls_led10
```kconfig
# Build variant: 4MB flash, software MBEDTLS, RGB LED on GPIO 10

# Flash configuration
CONFIG_ESPTOOLPY_FLASHSIZE_4MB=y
CONFIG_ESPTOOLPY_FLASHSIZE="4MB"
CONFIG_ESPTOOLPY_FLASHMODE_QIO=y
CONFIG_ESPTOOLPY_FLASHMODE="dio"
CONFIG_ESPTOOLPY_FLASHFREQ_80M=y
CONFIG_ESPTOOLPY_FLASHFREQ="80m"

# ATECC608A I2C pin assignment (board-specific, overrides Kconfig defaults of 21/22)
CONFIG_ATECC608A_TCUSTOM=y
CONFIG_ATCA_I2C_SDA_PIN=41
CONFIG_ATCA_I2C_SCL_PIN=40
CONFIG_ATCA_I2C_ADDRESS=0xC0
CONFIG_ATCA_I2C_BAUD_RATE=100000

# Software crypto path (no ATECC hardware ECDSA)
CONFIG_TOOTHPASTE_SOFTWARE_CRYPTO=y

# RGB LED pin
CONFIG_TOOTHPASTE_RGB_LED_PIN=10
```

## firmware/sdkconfig.defaults.8mb_atecc
```kconfig
# Build variant: 8MB flash, ATECC608A hardware ECDSA via MBEDTLS

# Flash configuration
CONFIG_ESPTOOLPY_FLASHSIZE_8MB=y
CONFIG_ESPTOOLPY_FLASHSIZE="8MB"
CONFIG_ESPTOOLPY_FLASHMODE_QIO=y
CONFIG_ESPTOOLPY_FLASHMODE="dio"
CONFIG_ESPTOOLPY_FLASHFREQ_80M=y
CONFIG_ESPTOOLPY_FLASHFREQ="80m"

# ATECC608A hardware ECDSA (TrustCustom chip on I2C pins 41/40)
CONFIG_ATECC608A_TCUSTOM=y
CONFIG_ATCA_I2C_SDA_PIN=41
CONFIG_ATCA_I2C_SCL_PIN=40
CONFIG_ATCA_I2C_ADDRESS=0xC0
CONFIG_ATCA_I2C_BAUD_RATE=100000
CONFIG_ATCA_MBEDTLS_ECDSA=y
```
